#include "net.h"
#include "display.h"
#include <ESP8266WiFi.h>
#include <ESP8266WebServer.h>
#include <ESP8266mDNS.h>
#include <Updater.h>
#include <WiFiManager.h>
#include <build_secrets.h>   // generated by scripts/secrets.py; may define nothing

#define OTA_USER "admin"
#ifndef OTA_PASS
#warning "OTA_PASS is not set: anyone on the LAN can flash firmware or reboot the device"
#endif

static ESP8266WebServer server(80);
static uint32_t         rebootAt = 0;

bool timeValid() { return time(nullptr) > 1609459200; }   // after 2021-01-01

static bool waitConnected(uint32_t ms) {
  uint32_t start = millis();
  while (WiFi.status() != WL_CONNECTED && millis() - start < ms) delay(100);
  return WiFi.status() == WL_CONNECTED;
}

// ---- access control --------------------------------------------------------
// Browsers send Origin (or at least Referer) with a cross-site POST, so one that
// names another site came from some other web page. curl sends neither.
static bool sameOrigin() {
  const String self = "http://" + server.hostHeader();
  const String& origin = server.header("Origin");
  if (origin.length()) return origin.equalsIgnoreCase(self);
  const String& ref = server.header("Referer");
  if (ref.length()) return ref.equalsIgnoreCase(self) || ref.startsWith(self + "/");
  return true;
}

static bool authorized() {
#ifdef OTA_PASS
  return server.authenticate(OTA_USER, OTA_PASS);
#else
  return true;
#endif
}

// For requests that change state: replies and returns false when not allowed.
static bool guardPost() {
  if (!sameOrigin()) {
    server.send(403, "text/plain", "Cross-origin request refused");
    return false;
  }
  if (!authorized()) {
    server.requestAuthentication();
    return false;
  }
  return true;
}

// ---- web pages -------------------------------------------------------------
static const char kHead[] PROGMEM =
    "<!doctype html><html><head><meta charset=utf-8>"
    "<meta name=viewport content='width=device-width,initial-scale=1'><title>SmallTV</title>"
    "<style>body{font-family:system-ui,sans-serif;background:#0e1116;color:#e6edf3;"
    "max-width:480px;margin:2em auto;padding:0 1em}td{padding:3px 12px 3px 0}"
    "td:first-child{color:#8b96a5}a,button{color:#58a6ff}button{background:#171c24;"
    "border:1px solid #30363d;border-radius:6px;padding:6px 12px;margin:4px 4px 0 0;cursor:pointer}"
    "</style></head><body>";

static String htmlEscape(const String& s) {
  String o;
  o.reserve(s.length());
  for (char c : s) {
    switch (c) {
      case '&': o += F("&amp;"); break;
      case '<': o += F("&lt;"); break;
      case '>': o += F("&gt;"); break;
      case '"': o += F("&quot;"); break;
      case '\'': o += F("&#39;"); break;
      default: o += c;
    }
  }
  return o;
}

static String uptimeStr() {
  uint32_t s = (uint32_t)(micros64() / 1000000);   // millis() wraps after 49.7 days
  char b[32];
  snprintf(b, sizeof(b), "%ud %02u:%02u:%02u", s / 86400, (s / 3600) % 24, (s / 60) % 60, s % 60);
  return b;
}

static void handleRoot() {
  time_t now = time(nullptr);
  char timeBuf[32] = "not synced";
  if (timeValid()) strftime(timeBuf, sizeof(timeBuf), "%Y-%m-%d %H:%M:%S", localtime(&now));

  String h;
  h.reserve(1800);
  h += FPSTR(kHead);
  h += F("<h2>SmallTV</h2><table>");
  auto row = [&h](const char* k, const String& v) {
    h += F("<tr><td>"); h += k; h += F("</td><td>"); h += v; h += F("</td></tr>");
  };
  row("Firmware", String(FW_VERSION) + " (" __DATE__ " " __TIME__ ")");
  row("Time", timeBuf);
  row("Uptime", uptimeStr());
  row("Network", htmlEscape(WiFi.SSID()));
  row("IP", WiFi.localIP().toString());
  row("Signal", String(WiFi.RSSI()) + " dBm");
  row("Free heap", String(ESP.getFreeHeap()) + " B");
  row("Last reset", ESP.getResetReason());
  h += F("</table><p><a href=/update>Firmware update</a></p>"
         "<form method=post action=/reboot><button>Reboot</button></form>"
         "<form method=post action=/wifi/forget onsubmit=\"return confirm("
#ifdef WIFI_SSID
         "'Forget WiFi credentials and reboot? The device will rejoin the network built into the firmware.'"
#else
         "'Forget WiFi credentials and reboot into the setup portal?'"
#endif
         ")\"><button>Forget WiFi</button></form></body></html>");
  server.send(200, "text/html", h);
}

static void handleStatusJson() {
  char b[256];
  snprintf(b, sizeof(b),
           "{\"fw\":\"%s\",\"uptime\":%lu,\"ip\":\"%s\",\"rssi\":%d,\"heap\":%u,\"time\":%lld}",
           FW_VERSION, (unsigned long)(micros64() / 1000000), WiFi.localIP().toString().c_str(),
           WiFi.RSSI(), ESP.getFreeHeap(), (long long)time(nullptr));
  server.send(200, "application/json", b);
}

static void handleReboot() {
  if (!guardPost()) return;
  server.send(200, "text/plain", "Rebooting");
  rebootAt = millis() + 500;
}

static void handleForgetWifi() {
  if (!guardPost()) return;
  server.send(200, "text/plain", "WiFi credentials erased, rebooting");
  delay(200);
  WiFi.persistent(true);
  WiFi.disconnect(true);   // with persistent: also erases the stored credentials
  rebootAt = millis() + 500;
}

// ---- OTA -------------------------------------------------------------------
// Our own handler rather than ESP8266HTTPUpdateServer: that one sends
// "Access-Control-Allow-Origin: *" and can't refuse cross-site uploads.
static bool   otaAllowed = false;   // decided once the request headers are in
static bool   otaGotFile = false;
static String otaError;

static void otaFail() {
  StreamString s;
  Update.printError(s);
  otaError = s.length() ? String(s.c_str()) : String(F("unknown error"));
  Serial.printf("OTA error: %s\n", otaError.c_str());
}

static void handleUpdatePage() {
  if (!authorized()) return server.requestAuthentication();
  String h;
  h.reserve(1200);
  h += FPSTR(kHead);
  h += F("<h2>Firmware update</h2>"
         "<form method=post enctype=multipart/form-data>"
         "<p><input type=file name=firmware accept=.bin required></p>"
         "<button>Upload</button></form>"
         "<p>An upload takes about 2 minutes, then the device reboots.</p>"
         "<p><a href=/>Back</a></p></body></html>");
  server.send(200, "text/html", h);
}

static void handleUpdateUpload() {
  HTTPUpload& up = server.upload();
  switch (up.status) {
    case UPLOAD_FILE_START:
      otaError = "";
      otaGotFile = true;
      otaAllowed = sameOrigin() && authorized();
      if (!otaAllowed) return;
      Serial.printf("OTA: %s\n", up.filename.c_str());
      if (!Update.begin((ESP.getFreeSketchSpace() - 0x1000) & 0xFFFFF000, U_FLASH)) otaFail();
      break;
    case UPLOAD_FILE_WRITE:
      if (otaAllowed && !otaError.length() && Update.write(up.buf, up.currentSize) != up.currentSize)
        otaFail();
      break;
    case UPLOAD_FILE_END:
      if (otaAllowed && !otaError.length() && !Update.end(true)) otaFail();
      break;
    case UPLOAD_FILE_ABORTED:
      if (otaAllowed) Update.end();
      otaError = F("upload aborted");
      break;
  }
  yield();
}

static void handleUpdateDone() {
  const bool gotFile = otaGotFile, allowed = otaAllowed;
  otaGotFile = otaAllowed = false;   // don't leak into the next request
  if (!guardPost()) return;
  if (!gotFile || !allowed) return server.send(400, "text/plain", "No firmware file in request");
  if (otaError.length()) return server.send(500, "text/plain", "Update error: " + otaError);
  server.send(200, "text/html", F("<meta http-equiv=refresh content='15;url=/'>Update Success! Rebooting..."));
  rebootAt = millis() + 500;
}

// ---- WiFi ------------------------------------------------------------------
void netBegin() {
  WiFi.persistent(true);         // credentials live in the SDK's flash config
  WiFi.mode(WIFI_STA);
  WiFi.hostname(HOSTNAME);
  WiFi.setAutoReconnect(true);

  bool ok = false;
  // 1. Credentials stored by a previous run / the setup portal.
  if (WiFi.SSID().length()) {
    showMessage("CONNECTING", WiFi.SSID().c_str());
    WiFi.begin();
    ok = waitConnected(20000);
  }
#ifdef WIFI_SSID
  // 2. Build-time fallback (secrets.env). Not persisted: with persistence on,
  //    WiFi.begin() writes flash before connecting, so a router that's briefly
  //    down at boot would make it overwrite the network saved by the portal.
  if (!ok) {
    showMessage("CONNECTING", WIFI_SSID);
    WiFi.persistent(false);
#ifdef WIFI_PASS
    WiFi.begin(WIFI_SSID, WIFI_PASS);
#else
    WiFi.begin(WIFI_SSID);
#endif
    ok = waitConnected(20000);
    WiFi.persistent(true);
  }
#endif
  // 3. Captive setup portal. Times out and reboots, so after a router outage
  //    the device goes back to trying the stored network.
  if (!ok) {
    WiFiManager wm;
    wm.setDebugOutput(false);
    wm.setConfigPortalTimeout(300);
    wm.setConnectTimeout(20);
    wm.setHostname(HOSTNAME);
    wm.setAPCallback([](WiFiManager*) {
      showSetupPortal(SETUP_AP, WiFi.softAPIP().toString().c_str());
    });
    if (!wm.startConfigPortal(SETUP_AP)) {
      showMessage("NO WIFI", "Rebooting...");
      delay(1000);
      ESP.restart();
    }
  }

  MDNS.begin(HOSTNAME);
  MDNS.addService("http", "tcp", 80);

  server.collectHeaders("Origin", "Referer");   // Authorization is always collected
  server.on("/", HTTP_GET, handleRoot);
  server.on("/api/status", HTTP_GET, handleStatusJson);
  server.on("/update", HTTP_GET, handleUpdatePage);
  server.on("/update", HTTP_POST, handleUpdateDone, handleUpdateUpload);
  server.on("/reboot", HTTP_POST, handleReboot);
  server.on("/wifi/forget", HTTP_POST, handleForgetWifi);
  server.onNotFound([] { server.send(404, "text/plain", "Not found"); });
  server.begin();
}

void netLoop() {
  server.handleClient();
  MDNS.update();
  if (rebootAt && (int32_t)(millis() - rebootAt) >= 0) ESP.restart();
}

bool netConnected() { return WiFi.status() == WL_CONNECTED; }

void netStatusLine(char* buf, size_t len) {
  if (netConnected())
    snprintf(buf, len, "%s  %ddBm", WiFi.localIP().toString().c_str(), WiFi.RSSI());
  else
    snprintf(buf, len, "WiFi disconnected - retrying");
}
